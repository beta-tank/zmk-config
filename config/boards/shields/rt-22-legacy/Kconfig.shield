## config/boards/shields/rt-22-legacy/Kconfig.shield
```kconfig
# Copyright (c) 2021 The ZMK Contributors
# SPDX-License-Identifier: MIT

config SHIELD_RT-22-LEGACY_LEFT
	def_bool $(shields_list_contains,rt-22-legacy_left)

config SHIELD_RT-22-LEGACY_RIGHT
	def_bool $(shields_list_contains,rt-22-legacy_right)
```

## config/boards/shields/tbk_mini/Kconfig.defconfig
```kconfig
if SHIELD_TBK_MINI_LEFT

config ZMK_KEYBOARD_NAME
	default "TBK-Mini"

config ZMK_SPLIT_BLE_ROLE_CENTRAL
	default y

endif

if SHIELD_TBK_MINI_RIGHT

config ZMK_KEYBOARD_NAME
    default "TBK-Mini right"

endif

if SHIELD_TBK_MINI_LEFT || SHIELD_TBK_MINI_RIGHT

config ZMK_SPLIT
	default y

endif
```

## config/boards/shields/tbk_mini/Kconfig.shield
```kconfig
# SPDX-License-Identifier: MIT

config SHIELD_TBK_MINI_LEFT
	def_bool $(shields_list_contains,tbk_mini_left)

config SHIELD_TBK_MINI_RIGHT
	def_bool $(shields_list_contains,tbk_mini_right)
```
