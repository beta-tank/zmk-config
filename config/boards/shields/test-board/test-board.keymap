/*
 * Copyright (c) 2022 beta-tank
 * SPDX-License-Identifier: MIT
 */

 #include <behaviors.dtsi>
 #include <dt-bindings/zmk/keys.h>

 /*

 LEGEND: KEYCODE | NRFMICRO_PIN (ARDUINO_PIN)

 - | RAW          (1) 0.06 | 0
 - | GND          (0) 0.08 | 1
 - | RST              GND  | -
 - | VCC              GND  | -
 A | 0.30 (21)    (2) 0.15 | 2
 B | 0.31 (20)    (3) 0.17 | 3
 C | 0.29 (19)    (4) 0.20 | 4
 D | 0.02 (18)    (5) 0.13 | 5
 E | 1.13 (15)    (6) 0.24 | 6
 F | 0.03 (14)    (7) 0.09 | 7
 G | 0.28 (16)    (8) 0.10 | 8
 H | 1.11 (10)    (9) 1.06 | 9 
 
 */
 
 / {
        keymap {
                compatible = "zmk,keymap";
                default_layer {
                        bindings = <
                                &kp N0
                                &kp N1
                                &kp N2 
                                &kp N3
                                &kp N4 
                                &kp N5
                                &kp N6
                                &kp N7
                                &kp N8
                                &kp N9
                                &kp H 
                                &kp G 
                                &kp F 
                                &kp E 
                                &kp D 
                                &kp C 
                                &kp B 
                                &kp A
                                >;
                };
         };
 };